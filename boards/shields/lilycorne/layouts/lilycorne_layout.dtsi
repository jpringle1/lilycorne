#include <../physical_layouts.dtsi>

/ {
    lilycorne_layout: lilycorne_layout {
        compatible = "zmk,physical-layout";
        display-name = "6 Column";
    };

layouts_lilycorne_position_map: layouts_lilycorne_position_map {
        compatible = "zmk,physical-layout-position-map";
        complete;
   };

};


&layouts_lilycorne_position_map {
    lilycorne_posmap: six {
        physical-layout = <&lilycorne_layout>;
        positions
            = < 0  1  2  3  4  5      	 6  7  8  9 10>
            , <11 12 13 14 15 16 	17 18 19 20 21>
            , <22 23 24 25 26 27 	28 29 30 31 32>
            , <33 34 35 36 37 38 46 	39 40 41      >
            , <      42 43 44 45		      >;
    };
};
